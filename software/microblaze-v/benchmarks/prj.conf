## CMakeLists.txt
```
cmake_minimum_required(VERSION 3.20.0)

# Busca el Zephyr de este entorno concreto
find_package(Zephyr REQUIRED HINTS $ENV{ZEPHYR_BASE})
project(TFG)

# Compilamos el test de GPIO
target_sources(app PRIVATE src/main_math.c)
```

## prj.conf
```kconfig
# Periféricos básicos
CONFIG_GPIO=y
CONFIG_SERIAL=y
CONFIG_PRINTK=y
CONFIG_UART_CONSOLE=y

# Configuración de Librería C para evitar errores de enlazado
CONFIG_PICOLIBC=n
CONFIG_MINIMAL_LIBC=y


CONFIG_NEWLIB_LIBC=y
CONFIG_NEWLIB_LIBC_FLOAT_PRINTF=y
CONFIG_CBPRINTF_FP_SUPPORT=y
CONFIG_CPU_HAS_FPU=y
CONFIG_FPU=y
CONFIG_FLOAT_HARD=y
```

## zybo_z7_mbv.overlay
```dts
/ {

        aliases {

                test-pin = &test_gpio_fpga;

        };



        leds {

                test_gpio_fpga: test_gpio_fpga_node {

                        gpios = <&gpio0 0 GPIO_ACTIVE_HIGH>;

                        label = "Pin de test MicroBlaze";

                };

        };

};
```

## src/main_gpio.c
```c
#include <zephyr/kernel.h>
#include <zephyr/drivers/gpio.h>
#include <zephyr/sys_clock.h>

// --- Comunicación directa con la UART del PS (Zynq-7000) ---
#define UART_BASE      0xE0001000
#define UART_FIFO      (UART_BASE + 0x30)
#define UART_SR        (UART_BASE + 0x2C)
#define UART_SR_TXFULL (1 << 4)

static void uart_putc(char c)
{
    volatile uint32_t *sr   = (volatile uint32_t *)UART_SR;
    volatile uint32_t *fifo = (volatile uint32_t *)UART_FIFO;
    while (*sr & UART_SR_TXFULL);
    *fifo = c;
}

static void uart_puts(const char *s)
{
    while (*s) uart_putc(*s++);
}

// Función auxiliar para convertir un entero a texto (Base 10)
static void uart_put_uint32(uint32_t val)
{
    char buf[12];
    int i = 10;
    buf[11] = '\0';
    
    if (val == 0) {
        uart_puts("0");
        return;
    }
    
    while (val > 0 && i >= 0) {
        buf[i--] = (val % 10) + '0';
        val /= 10;
    }
    uart_puts(&buf[i + 1]);
}

// Función para calcular y mostrar microsegundos basados en el reloj del sistema
static void uart_put_microseconds(uint32_t cycles)
{
    uint32_t freq_mhz = CONFIG_SYS_CLOCK_HW_CYCLES_PER_SEC / 1000000; 
    
    if (freq_mhz == 0) {
        freq_mhz = 100; 
    }

    uint32_t us_enteros = cycles / freq_mhz;
    uint32_t us_decimales = cycles % freq_mhz;

    uart_put_uint32(us_enteros);
    uart_puts(".");
    
    if (us_decimales < 10) {
        uart_puts("0");
    }
    uart_put_uint32(us_decimales);
    uart_puts(" us");
}

// Vinculación con el alias 'test-pin' definido en tu archivo .overlay
static const struct gpio_dt_spec pin = GPIO_DT_SPEC_GET(DT_ALIAS(test_pin), gpios);

int main(void)
{
    uint32_t start_cycles, end_cycles, total_cycles;
    uint32_t test_count = 1;

    // Verificar que el periférico está listo en Zephyr y configurarlo como salida
    if (!device_is_ready(pin.port)) {
        uart_puts("Error: El periferico GPIO no esta listo.\r\n");
        return 0;
    }
    gpio_pin_configure_dt(&pin, GPIO_OUTPUT_ACTIVE);

    uart_puts("\r\n=== Monitor de Benchmark GPIO en bucle activo ===\r\n");

    // BUCLE INFINITO DEL EXPERIMENTO
    while (1) {
        uart_puts("Ejecucion #");
        uart_put_uint32(test_count++);
        uart_puts("...\r\n");

        // ========================================================
        // TOMA DE TIEMPOS - ENTORNO DE PRUEBA
        // ========================================================
        start_cycles = k_cycle_get_32();

        for (int i = 0; i < 10000; i++) {
            gpio_pin_set_dt(&pin, 1);
            gpio_pin_set_dt(&pin, 0);
        }

        end_cycles = k_cycle_get_32();
        // ========================================================

        total_cycles = end_cycles - start_cycles;

        // Volcado de resultados
        uart_puts("Ciclos: ");
        uart_put_uint32(total_cycles);
        uart_puts(" | Tiempo: ");
        uart_put_microseconds(total_cycles);
        uart_puts("\r\n-----------------------------------\r\n");

        // Un pequeño retardo manual por hardware (sin dormir el kernel) 
        // para no saturar el buffer de tu pantalla en el PC
        for (volatile int delay = 0; delay < 2000000; delay++) {
            __asm__ volatile("nop");
        }
    }

    return 0;
}
```

## src/main_math.c
```c
#include <zephyr/kernel.h>
#include <zephyr/sys/printk.h>
#include <math.h>

// --- Comunicación directa con la UART del PS (Zynq-7000) ---
#define UART_BASE      0xE0001000
#define UART_FIFO      (UART_BASE + 0x30)
#define UART_SR        (UART_BASE + 0x2C)
#define UART_SR_TXFULL (1 << 4)

static void uart_putc(char c)
{
    volatile uint32_t *sr   = (volatile uint32_t *)UART_SR;
    volatile uint32_t *fifo = (volatile uint32_t *)UART_FIFO;
    while (*sr & UART_SR_TXFULL);
    *fifo = c;
}

static void uart_puts(const char *s)
{
    while (*s) uart_putc(*s++);
}

// Función auxiliar para convertir un entero a texto (Base 10)
static void uart_put_uint32(uint32_t val)
{
    char buf[12];
    int i = 10;
    buf[11] = '\0';
    
    if (val == 0) {
        uart_puts("0");
        return;
    }
    
    while (val > 0 && i >= 0) {
        buf[i--] = (val % 10) + '0';
        val /= 10;
    }
    uart_puts(&buf[i + 1]);
}

// Función para calcular y mostrar microsegundos basados en el reloj del sistema
static void uart_put_microseconds(uint32_t cycles)
{
    uint32_t freq_mhz = CONFIG_SYS_CLOCK_HW_CYCLES_PER_SEC / 1000000; 
    
    if (freq_mhz == 0) {
        freq_mhz = 100; 
    }

    uint32_t us_enteros = cycles / freq_mhz;
    uint32_t us_decimales = cycles % freq_mhz;

    uart_put_uint32(us_enteros);
    uart_puts(".");
    
    if (us_decimales < 10) {
        uart_puts("0");
    }
    uart_put_uint32(us_decimales);
    uart_puts(" us");
}

int main(void)
{
    uint32_t start_cycles, end_cycles, total_cycles;
    
    // Variables volatile para evitar que el compilador optimice y elimine el bucle
    volatile float a = 12.34f;
    volatile float b = 56.78f;
    volatile float resultado = 0.0f;

    uart_puts("\n--- BENCHMARK MATEMATICO (PUNTO FLOTANTE) - MICROBLAZE V ---\n");

    while (1) {
        // Captura de ciclos iniciales
        start_cycles = k_cycle_get_32();

        // Bucle de carga matemática pesada
        for (int i = 0; i < 10000; i++) {
            resultado = (a * b) / (a + b) + sinf((float)i);
        }

        // Captura de ciclos finales
        end_cycles = k_cycle_get_32();

        // Cálculo de métricas
        total_cycles = end_cycles - start_cycles;

        // Imprimimos el resultado usando la UART mapeada del PS
        uart_puts("10.000 operaciones FP -> Ciclos de CPU: ");
        uart_put_uint32(total_cycles);
        uart_puts(" | Tiempo: ");
        uart_put_microseconds(total_cycles);
        uart_puts("\n");

        // Evitamos el warning de variable no usada
        (void)resultado; 

        k_msleep(2000);
    }

    return 0;
}
```

## src/main_terminal.c
```c
#include <zephyr/kernel.h>
#include <zephyr/sys/printk.h>

// --- Comunicación directa con la UART del PS (Zynq-7000) ---
#define UART_BASE      0xE0001000
#define UART_FIFO      (UART_BASE + 0x30)
#define UART_SR        (UART_BASE + 0x2C)
#define UART_SR_TXFULL (1 << 4)

static void uart_putc(char c)
{
    volatile uint32_t *sr   = (volatile uint32_t *)UART_SR;
    volatile uint32_t *fifo = (volatile uint32_t *)UART_FIFO;
    while (*sr & UART_SR_TXFULL);
    *fifo = c;
}

static void uart_puts(const char *s)
{
    while (*s) uart_putc(*s++);
}

// Función auxiliar para convertir un entero a texto (Base 10)
static void uart_put_uint32(uint32_t val)
{
    char buf[12];
    int i = 10;
    buf[11] = '\0';
    
    if (val == 0) {
        uart_puts("0");
        return;
    }
    
    while (val > 0 && i >= 0) {
        buf[i--] = (val % 10) + '0';
        val /= 10;
    }
    uart_puts(&buf[i + 1]);
}

// Función para calcular y mostrar microsegundos basados en el reloj del sistema
static void uart_put_microseconds(uint32_t cycles)
{
    uint32_t freq_mhz = CONFIG_SYS_CLOCK_HW_CYCLES_PER_SEC / 1000000; 
    
    if (freq_mhz == 0) {
        freq_mhz = 100; 
    }

    uint32_t us_enteros = cycles / freq_mhz;
    uint32_t us_decimales = cycles % freq_mhz;

    uart_put_uint32(us_enteros);
    uart_puts(".");
    
    if (us_decimales < 10) {
        uart_puts("0");
    }
    uart_put_uint32(us_decimales);
    uart_puts(" us");
}

int main(void)
{
    uint32_t start_cycles, end_cycles, total_cycles;

    uart_puts("\n--- BENCHMARK DE TERMINAL (SOBRECARGA DE UART) - MICROBLAZE V ---\n");

    while (1) {
        // Margen para que se vacíe el hardware de la UART antes del test
        k_msleep(100);

        // Captura de ciclos iniciales (reloj de CPU síncrono en la FPGA)
        start_cycles = k_cycle_get_32();

        // Ráfaga masiva a bajo nivel por registro sin pasar por la capa de Zephyr
        for (int i = 0; i < 100; i++) {
            uart_puts("Iteracion [");
            uart_put_uint32(i);
            uart_puts("]: Evaluando la velocidad de transmision de la UART y el buffer en Zephyr RTOS.\n");
        }

        // Captura de ciclos finales
        end_cycles = k_cycle_get_32();

        // Cálculo de métricas temporales
        total_cycles = end_cycles - start_cycles;

        // Imprimimos el resultado de forma segura
        k_msleep(500);
        uart_puts("\n>>> FIN TEST: 100 lineas impresas. Ciclos totales: ");
        uart_put_uint32(total_cycles);
        uart_puts(" | Tiempo: ");
        uart_put_microseconds(total_cycles);
        uart_puts(" <<<\n\n");

        k_msleep(3000);
    }

    return 0;
}
```
