## software/microblaze-v/board/zybo_z7_mbv/zybo_z7_mbv_defconfig
```kconfig
#
# Copyright (c) 2024 Advanced Micro Devices, Inc.
#
# SPDX-License-Identifier: Apache-2.0
#

CONFIG_XIP=n
CONFIG_SYS_CLOCK_HW_CYCLES_PER_SEC=100000000
CONFIG_HEAP_MEM_POOL_SIZE=4096
CONFIG_PICOLIBC=n
CONFIG_NEWLIB_LIBC=n
CONFIG_MINIMAL_LIBC=y
CONFIG_STDOUT_CONSOLE=y
CONFIG_PRINTK=y
CONFIG_UART_XLNX_PS=y
```
